## scanner_firmware/main/Kconfig.projbuild
```kconfig
menu "APPLICATION SETTINGS"

    config ESP_WIFI_SSID
        string "WiFi SSID"
        default "myssid"
        help
            SSID (network name) for the example to connect to.

    config ESP_WIFI_PASSWORD
        string "WiFi Password"
        default "mypassword"
        help
            WiFi password (WPA or WPA2) for the example to use.

    config ESP_MAXIMUM_RETRY
        int "Maximum retry"
        default 5
        help
            Set the Maximum retry to avoid station reconnecting to the AP unlimited when the AP is really inexistent.

    config API_HOST
        string "API host url"
        default "localhost"
        help
            Set the host url of the API
    
    config API_PORT
        int "API port"
        default 3000
        help
            Set the port of the API

    config SHOW_DURATION
        int "Show duration"
        default 5000
        help
            Set the amount of ms a product is shown on the screen
endmenu
```
